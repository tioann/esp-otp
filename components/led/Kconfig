## components/led/Kconfig
```kconfig
menu "esp-otp status LED"

    config OTP_LED_ENABLE
        bool "Enable status LED"
        default y
        help
            Drive an indicator LED that reflects the clock-sync state: steady
            when synced within the last day, breathing when there is no time
            and no RTC, off otherwise.

    config OTP_LED_GPIO
        int "Status LED GPIO"
        depends on OTP_LED_ENABLE
        default 8
        help
            The C3 super mini's onboard blue LED is on GPIO8. GPIO8 is a
            strapping pin, but that only matters at power-on; driving it after
            boot is fine.

    config OTP_LED_ACTIVE_LOW
        bool "LED is active low"
        depends on OTP_LED_ENABLE
        default y
        help
            The C3 super mini's onboard LED lights when the pin is driven LOW.
            Enable for that board; disable for an LED wired active-high.

    config OTP_LED_INTENSITY
        int "Steady brightness percent (0-100)"
        depends on OTP_LED_ENABLE
        range 0 100
        default 30
        help
            Brightness of the steady "synced recently" state, and the peak of
            the breathing pulse.

endmenu
```

## components/store/Kconfig
```kconfig
menu "esp-otp secret store"

    config OTP_STORE_CAPACITY
        int "Maximum number of stored TOTP secrets"
        default 32
        range 1 128
        help
            Records are held in RAM and mirrored to NVS. Each record is
            roughly 110 bytes, so 32 secrets cost ~3.5 KB.

endmenu
```

## main/Kconfig.projbuild
```kconfig
menu "esp-otp hardware"

    config OTP_I2C_SDA_GPIO
        int "I2C SDA GPIO (OLED + optional DS3231)"
        default 5
        help
            Shared I2C data line. Avoid strapping pins (2, 8, 9).

    config OTP_I2C_SCL_GPIO
        int "I2C SCL GPIO (OLED + optional DS3231)"
        default 6

    config OTP_BUTTON_GPIO
        int "Push button GPIO (active low)"
        default 9
        help
            The C3 super mini's onboard BOOT button is on GPIO9 (active low,
            has a pull-up). Reused here as the user button. Don't hold it at
            power-on or the ROM enters USB download mode.

    config OTP_DEMO_MODE
        bool "Demo mode (seed a test secret + time at boot)"
        default n
        help
            For QEMU/bring-up: if the store is empty, seed a demo TOTP secret,
            and if time is unset, set a fixed epoch so a code is computed
            immediately without a host. Leave OFF for production.

endmenu
```
